## app/Kconfig
```kconfig
menuconfig APP_HEARTBEAT
	bool "App heartbeat"
	default y

if APP_HEARTBEAT
	config APP_HEARTBEAT_PERIOD_MS
		int "App heartbeat period (ms)"
		default 500
		range 100 2000

endif # APP_HEARTBEAT



source "Kconfig.zephyr"
```
